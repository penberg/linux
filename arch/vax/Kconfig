## arch/vax/Kconfig
```kconfig
config VAX
	def_bool y
	select GENERIC_IRQ_SHOW
	select GENERIC_IOMAP
	select GENERIC_ATOMIC64
	select HAVE_MEMBLOCK
	select HAVE_MEMBLOCK_NODE_MAP
	select ARCH_DISCARD_MEMBLOCK
	select GENERIC_CPU_DEVICES
	select GENERIC_CLOCKEVENTS
	select HAVE_MOD_ARCH_SPECIFIC
	select VIRT_TO_BUS
	select MODULES_USE_ELF_REL
	select CLONE_BACKWARDS

config MMU
	def_bool y

config HZ
	int
	default 100

config NO_DMA
	bool
	default y

config RWSEM_GENERIC_SPINLOCK
	def_bool y

config GENERIC_CSUM
	def_bool y

config GENERIC_HWEIGHT
	def_bool y

config GENERIC_CALIBRATE_DELAY
	def_bool y

config KERNEL_START
	hex
	default 0x80100000

source "init/Kconfig"

source "mm/Kconfig"

source "net/Kconfig"

source "drivers/Kconfig"

source "fs/Kconfig"

source "arch/vax/Kconfig.debug"

source "security/Kconfig"

source "crypto/Kconfig"

source "lib/Kconfig"

config NO_IOMEM
       def_bool y
```

## arch/vax/Kconfig.debug
```kconfig
menu "Kernel hacking"

source "lib/Kconfig.debug"

config EARLY_PRINTK
	bool "Early printk"
	default y
	---help---
	  Write kernel log output directly to the serial console.

	  This is useful for kernel debugging when your machine crashes very
	  early before the console code is initialized.

endmenu
```
